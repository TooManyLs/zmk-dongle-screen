## config/west.yml
```yaml
manifest:
  remotes:
    - name: zmkfirmware
      url-base: https://github.com/zmkfirmware
  projects:
    - name: zmk
      remote: zmkfirmware
      revision: ac7f75b8591d39aaf3b66b9d26f26c9ed921a009
      import: app/west.yml
  self:
    path: config
```
